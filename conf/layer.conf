## conf/layer.conf
```bitbake
# We have a conf and classes directory, add to BBPATH
BBPATH .= ":${LAYERDIR}"

# We have recipes-* directories, add to BBFILES
BBFILES += "${LAYERDIR}/recipes-*/*/*.bb \
            ${LAYERDIR}/recipes-*/*/*.bbappend"

BBFILE_COLLECTIONS += "meta-imx-sparkon"
BBFILE_PATTERN_meta-imx-sparkon = "^${LAYERDIR}/"
BBFILE_PRIORITY_meta-imx-sparkon = "6"
```
